## mchp_common/modules/mchp_serial/Kconfig
```kconfig
menu "MCHP Serial Protocol"

config USE_MCHP_SERIAL
    bool "MCHP serial measurement protocol"
    default y

endmenu
```

## mchp_hrm_gfx/Kconfig
```kconfig
source "Kconfig.zephyr"

menu "Application Options"

config USE_IMG_UTIL
    bool "Enable image utilities"
    default y

endmenu
```

## mchp_hrm_gfx/modules/ws2812_common/Kconfig
```kconfig
menu "WS2812 Common"

config USE_WS2812
    bool "WS2812 common library"
    default y

endmenu    
```

## west.yml
```yaml
manifest:
  remotes:
    - name: zephyrproject
      url-base: https://github.com/zephyrproject-rtos

  projects:
    - name: zephyr
      remote: zephyrproject
      revision: v4.3.0
      import:
        name-allowlist:
          - cmsis
          - cmsis_6
          - hal_atmel
          - lvgl
          - fatfs
          - picolibc

  self:
    path: mchp_zephyr_examples
```
